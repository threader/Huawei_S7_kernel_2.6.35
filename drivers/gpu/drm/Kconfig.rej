## drivers/gpu/drm/Kconfig.rej
```kconfig
--- drivers/gpu/drm/Kconfig
+++ drivers/gpu/drm/Kconfig
@@ -96,7 +96,10 @@
 config DRM_I915
 	tristate "i915 driver"
 	depends on AGP_INTEL
+	# we need shmfs for the swappable backing store, and in particular
+	# the shmem_readpage() which depends upon tmpfs
 	select SHMEM
+	select TMPFS
 	select DRM_KMS_HELPER
 	select FB_CFB_FILLRECT
 	select FB_CFB_COPYAREA
```

## drivers/net/wireless/bcm4329/Kconfig
```kconfig
config BCM4329
	tristate "Broadcom 4329 wireless cards support"
	depends on WIRELESS_EXT && MMC
	---help---
	  This module adds support for wireless adapters based on
	  Broadcom 4329 chipset.

	  This driver uses the kernel's wireless extensions subsystem.

	  If you choose to build a module, it'll be called dhd. Say M if
	  unsure.

config BCM4329_FW_PATH
	depends on BCM4329
	string "Firmware path"
#	default "/system/etc/firmware/fw_bcm4329.bin"
	default "/system/etc/wifi/rtecdc-bcm4329.bin"
	---help---
	  Path to the firmware file.

config BCM4329_firmware_softap_path
        depends on BCM4329
        string "Software access point firmware path"
#firmware_softap_path=/system/etc/wifi/rtecdc-apsta-bcm4329.bin
        default "/system/etc/wifi/rtecdc-apsta-bcm4329.bin"
        ---help---
          Path to the software AP firmware file.

config BCM4329_NVRAM_PATH
	depends on BCM4329
	string "NVRAM path"
#default "/proc/calibration"
	default "/system/etc/wifi/nvram-bcm4329.txt"
	---help---
	  Path to the calibration file.
```
